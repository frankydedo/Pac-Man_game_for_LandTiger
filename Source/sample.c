/*----------------------------------------------------------------------------
 * Name:    sample.c
 * Purpose: to control led through EINT buttons and manage the bouncing effect
 *        	- key1 switches on the led at the left of the current led on, 
 *					- it implements a circular led effect. 	
  * Note(s): this version supports the LANDTIGER Emulator
 * Author: 	Paolo BERNARDI - PoliTO - last modified 15/12/2020
 *----------------------------------------------------------------------------
 *
 * This software is supplied "AS IS" without warranties of any kind.
 *
 * Copyright (c) 2017 Politecnico di Torino. All rights reserved.
 *----------------------------------------------------------------------------*/
                
#include "LPC17xx.h"                    /* LPC17xx definitions                */
#include "led/led.h"
#include "button_EXINT/button.h"
#include "RIT/RIT.h"
#include "timer/timer.h"
#include "GLCD/GLCD.h" 
#include "../shared.h"
#include "TouchPanel/TouchPanel.h"

//#include "joystick/joystick.h"
//#include "adc/adc.h"

extern int ASM_funct(int, int, int, int, int, int, int*);
extern void drawMap();

void LCD_DisplayPacMan(const uint16_t *image, int width, int height, int x0, int y0, int current_xspd, int current_yspd) {
	int x, y, x2, y2;
	int i;
	i	= 0;
	if (current_xspd != 0) { 
    if(current_xspd>0){ // moving right
			for (y = 0; y < height; y++) {	
        for (x = 0; x < width; x++) {
					LCD_SetPoint((x+x0)%240, (y+y0)%320, image[i]);
						i++;
        }
			}
		}else{ // moving left
			
			for (y = height-1; y >=0; y--) {	
        for (x = width-1; x >= 0; x--) {
					LCD_SetPoint((x+x0)%240, (y+y0)%320, image[i]);
					i++;
        }
			}
		}
	}
	else {
    if(current_yspd>0){	//moving up
		
	for (x = 0; x < width; x++) {
        for (y = 0; y < height; y++) {
            LCD_SetPoint((x+x0)%240, (y+y0)%320, image[i]);
						i++;
        }
			}
		}else{ //moving down
			
			for (x = width-1; x >= 0; x--) {
        for (y = height-1; y >= 0; y--) {
            LCD_SetPoint((x+x0)%240, (y+y0)%320, image[i]);
						i++;
        }
			}
		}
	}
}

void LCD_DisplayBlinky(const uint16_t *image, int width, int height, int x0, int y0, int current_xspd, int current_yspd) {
	int x, y, x2, y2;
	int i;
	i= 0;
	for (y = 0; y < height; y++) {	
		for (x = 0; x < width; x++) {
			LCD_SetPoint((x+x0)%240, (y+y0)%320, image[i]);
			i++;
		}
	}
}

uint16_t pacman_life [] = {
	0x0000, 0x0000, 0x0000, 0x0000, 0x0000, 0x0000, 0x0000, 0x0000, 0x0000, 0x0000, 0x0000, 0x0000, 0x0000, 0x0000, 0x0000, 0x0000, 
	0x0000, 0x0000, 0x0000, 0xffff, 0xffff, 0xffff, 0xffff, 0xffff, 0xffdf, 0x0000, 0x0000, 0x0000, 0x0000, 0x0000, 0x0000, 0x0000, 
	0x0000, 0xffff, 0xffff, 0xffff, 0xffff, 0xffff, 0xffff, 0xffff, 0xffff, 0x0000, 0x0000, 0x0000, 0x0000, 0x0000, 0x0000, 0xffff, 
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	0x0000, 0x0000, 0x0000, 0x0000, 0x0000, 0x0000, 0x0000, 0x0000, 0x0000, 0x0000, 0x0000, 0x0000, 0x0000, 0x0000, 0x0000, 0x0000, 
	0x0000
};

uint16_t empty_life [] = {
	0x0000, 0x0000, 0x0000, 0x0000, 0x0000, 0x0000, 0x0000, 0x0000, 0x0000, 0x0000, 0x0000, 0x0000, 0x0000, 0x0000, 0x0000, 0x0000, 
	0x0000, 0x0000, 0x0000, 0x0000, 0x0000, 0x0000, 0x0000, 0x0000, 0x0000, 0x0000, 0x0000, 0x0000, 0x0000, 0x0000, 0x0000, 0x0000, 
	0x0000, 0x0000, 0x0000, 0x0000, 0x0000, 0x0000, 0x0000, 0x0000, 0x0000, 0x0000, 0x0000, 0x0000, 0x0000, 0x0000, 0x0000, 0x0000, 
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	0x0000, 0x0000, 0x0000, 0x0000, 0x0000, 0x0000, 0x0000, 0x0000, 0x0000, 0x0000, 0x0000, 0x0000, 0x0000, 0x0000, 0x0000, 0x0000,  
	0x0000
};

void displayLives(int lives) {
	int	x, y, cnt;
	for (cnt = 0; cnt<lives; cnt++){
		int i=0;
		for (y = 0; y < 15; y++) {
			for (x = 0; x < 15; x++) {
				LCD_SetPoint(x+55 + cnt*20, (y+300), pacman_life[i]);
				i++;
			}
		}
	}
}

#ifdef SIMULATOR
extern uint8_t ScaleFlag; // <- ScaleFlag needs to visible in order for the emulator to find the symbol (can be placed also inside system_LPC17xx.h but since it is RO, it needs more work)
#endif
/*----------------------------------------------------------------------------
  Main Program
 *----------------------------------------------------------------------------*/


char remainingTime[3];
int timer = 60;
int pause = 1;
int nextInput = 0;

int lives = 1;
int scoreLivesCounter = 0;
	
uint32_t ghost_speed = 0x3D090;

int main (void) {
  	
	SystemInit();  												/* System Initialization (i.e., PLL)  */
	//LED_init();                           /* LED Initialization                 */
	BUTTON_init();												/* BUTTON Initialization              */
	
	ADC_init();	

	CAN_Init();
	LCD_Initialization();

	LPC_SC -> PCONP |= (1 << 22);  // TURN ON TIMER 2
	LPC_SC -> PCONP |= (1 << 23);  // TURN ON TIMER 3	
	LPC_PINCON->PINSEL1 |= (1<<21);
	LPC_PINCON->PINSEL1 &= ~(1<<20);
	LPC_GPIO0->FIODIR |= (1<<26);

	
	LCD_Clear(Black);
	joystick_init();
	
	init_RIT(0x004C4B40);									/* RIT Initialization 50 msec       */
	enable_RIT();													/* enable RIT to count 50ms				 */
	
	drawMap();
	GUI_Text(0, 17, (uint8_t *) "SCORE:", Black, White);
	GUI_Text(0, 0, (uint8_t *) "Game Over in:", White, Black);
	GUI_Text(5, 300, (uint8_t *) "Lives:", White, Black);

	
	if (pause==0){
		CAN_send();
		//init_timer(0, 0, 0, 3, 0x17D7840);	//25.000.000 == 1
		init_timer(1, 0, 0, 3, 0x3D090);	// 250.000 == 0.01
		init_timer(2, 0, 0, 3, ghost_speed);
		//enable_timer(0);
		enable_timer(1);
		enable_timer(2);
	}else if (pause==1){
		CAN_send();
		GUI_Text(x_pause, y_pause, (uint8_t *) "PAUSE", Black, White);
		//init_timer(0, 0, 0, 3, 0x17D7840);
		init_timer(1, 0, 0, 3, 0x3D090);
		init_timer(2, 0, 0, 3, ghost_speed);
	}


	LPC_SC->PCON |= 0x1;									/* power-down	mode										*/
	LPC_SC->PCON &= ~(0x2);						
		
  while (1) {                           /* Loop forever                       */	
		__ASM("wfi");
  }

}
